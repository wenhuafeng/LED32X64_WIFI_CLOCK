

#include <math.h>
#include <stdio.h>
#include <string.h>
#include "stm32f1xx_hal.h"

#include "TypeDefine.h"
#include "HUB75D.h"
#include "HTU21D.h"
#include "ESP8266_AT.h"
#include "main.h"
#include "RTC_software.h"

u16 HUB75D_DispOffCtr;

#define HUB75D_DISP_POWER_PIN    PBout(11)

HUB75D_DispTHFlag F_HUB75D_TH_DISP_CHANGE;
HUB75D_DispOnOffFlag F_HUB75D_DISP_ON_OFF;

u8 Mode;
u8 Color;
u8 fractional_frequency;

u8 COUNT=15,COUNT1,ADC_Count,LINE=15,G,T,speed;

u8 f1,f0,s1,s0,h1,h0,sd,d1,d0,m1,m0,y1,y0,wk;
u8 sign, t1, t0, td;
u8 nd1, nd0, nm1, nm0, ny1, ny0,a1, a0;
u8 zr[16], zg[16], zb[16];

extern u8 IRCOM[];

u8 const Fu_Tbl[] =
{
  0xFF,0xFF,0xFF,0xFF,0xFF,0xFF,0xFF,0xFF,0xC1,0xC0,0x00,0x00,0x00,0x00,0x00,0x03,
  0x80,0x80,0x01,0x80,0x0F,0x80,0x00,0x01,0x80,0x80,0x00,0xF1,0xFF,0xC0,0x00,0x01,
  0x81,0xC0,0x00,0xF9,0xFF,0x80,0x87,0x85,0x83,0xE0,0x03,0xF8,0xFC,0x00,0xCF,0xCD,
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  0xC0,0x00,0x00,0x00,0x00,0x00,0x00,0x03,0xFF,0xFF,0xFF,0xFF,0xFF,0xFF,0xFF,0xFF
};

u8 const tab2[16][4]=
{
  {0,0,0,0},{0,6,2,5},{1,2,5,0},{1,8,7,5},
  {2,5,0,0},{3,1,2,5},{3,7,5,0},{4,3,7,5},
  {5,0,0,0},{5,6,2,5},{6,2,5,0},{6,8,7,5},
  {7,5,0,0},{8,1,2,5},{8,7,5,0},{9,3,7,5}
};

u8 const ZF[]=
{
  0x00,0x06,0x09,0x09,0x09,0x09,0x09,0x06, //0
  0x00,0x02,0x06,0x02,0x02,0x02,0x02,0x07, //1
  0x00,0x06,0x09,0x01,0x02,0x04,0x08,0x0f, //2
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  0x00,0x00,0x80,0x00,0x30,0x40,0x40,0x30, //19 .c 4x7
};

u8 const HZ[]=
{
  0x00,0x3e,0x22,0x22,0x3e,0x22,0x22,0x3e, //0 日
  0x00,0x00,0x00,0x00,0x00,0x7e,0x00,0x00, //1 一
  0x00,0x00,0x00,0x3c,0x00,0x00,0x7e,0x00, //2 二
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  0x08,0x1f,0x24,0x1f,0x14,0x3f,0x04,0x04, //10 年
};

u8 const DateD[][8]=
{
  0x00,0x70,0x88,0x88,0x88,0x88,0x88,0x70, //0
  0x00,0x20,0x60,0x20,0x20,0x20,0x20,0x70, //1
  0x00,0x70,0x88,0x08,0x10,0x20,0x40,0xf8, //2
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  0x00,0xc8,0xd0,0x20,0x58,0x98,0x00,0x00, //15 %
};

u8 const DZF[][16]=
{
  /*  --- 8x16 ---*/
  0x3c,0x7e,0xe7,0xc3,0xc3,0xc3,0xc3,0xc3,0xc3,0xc3,0xc3,0xc3,0xc3,0xe7,0x7e,0x3c, //0
  0x1c,0x7c,0x1c,0x1c,0x1c,0x1c,0x1c,0x1c,0x1c,0x1c,0x1c,0x1c,0x1c,0x1c,0x1c,0x7f, //1
  0x3c,0x7e,0xe7,0xc3,0xc3,0xc3,0x03,0x03,0x07,0x0e,0x1c,0x38,0x70,0xe1,0xff,0xff, //2
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  0x00,0x00,0xe0,0xa0,0xe0,0x00,0x1e,0x23,0x41,0x40,0x40,0x40,0x40,0x41,0x23,0x1e, //28 c
};

u8 const ZZF[][16]=
{
  0x00,0x00,0x3e,0x7f,0x63,0x63,0x63,0x63, 0x63, 0x63, 0x63, 0x63, 0x7f, 0x3e, 0x00, 0x00, //0
  0x00,0x00,0x1c,0x3c,0x1c,0x1c,0x1c,0x1c, 0x1c, 0x1c, 0x1c, 0x1c, 0x1c, 0x3e, 0x00, 0x00, //1
  0x00,0x00,0x3e,0x7f,0x63,0x63,0x07,0x0e, 0x1c, 0x38, 0x70, 0x60, 0x7f, 0x7f, 0x00, 0x00, //2
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  0x00,0x00,0x00,0x00,0x00,0x00,0x00,0x00, 0x00, 0x00, 0x00, 0x00, 0x00, 0x00, 0x00, 0x00, //11
};

//二维数据16x16
u8 const hanzi[28][32] = {
    0x1F,0xF8,0x01,0x00,0x7F,0xFE,0x41,0x04,0x1D,0x70,0x01,0x00,0x1D,0x70,0x02,0x80, /* 零 */
    0x04,0x60,0x1A,0x1E,0xE1,0x08,0x1F,0xE0,0x00,0x40,0x02,0x80,0x01,0x00,0x01,0x00,
    0x00,0x00,0x00,0x00,0x00,0x00,0x00,0x00,0x00,0x00,0x00,0x00,0x00,0x04,0x7F,0xFE, /* 一 */
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    0x24,0xA4,0x27,0xFC,0x20,0x00,0x23,0xF8,0x21,0x10,0x20,0xE0,0x23,0x18,0x2C,0x06,
};

/*------------农历程序-------------------------*/
const u8 year_code[597] = {
  0x04,0xAe,0x53,    //1901 0
  0x0A,0x57,0x48,    //1902 3
  0x55,0x26,0xBd,    //1903 6
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  0x2d,0x92,0xB5,    //2099
};

const u8 day_code1[9] = {0x0,0x1f,0x3b,0x5a,0x78,0x97,0xb5,0xd4,0xf3};
const u16 day_code2[3] = {0x111,0x130,0x14e};

//BOOLEAN c_moon;
u8 year_moon,month_moon,day_moon;

u8 get_moon_day(u8 month_p,u16 table_addr)
{
  u8 temp;

  switch (month_p){
    case 1:{temp=year_code[table_addr]&0x08;if (temp==0)return(0);else return(1);}
    case 2:{temp=year_code[table_addr]&0x04;if (temp==0)return(0);else return(1);}
    case 3:{temp=year_code[table_addr]&0x02;if (temp==0)return(0);else return(1);}
    case 4:{temp=year_code[table_addr]&0x01;if (temp==0)return(0);else return(1);}
    case 5:{temp=year_code[table_addr+1]&0x80;if (temp==0)return(0);else return(1);}
    case 6:{temp=year_code[table_addr+1]&0x40;if (temp==0)return(0);else return(1);}
    case 7:{temp=year_code[table_addr+1]&0x20;if (temp==0)return(0);else return(1);}
    case 8:{temp=year_code[table_addr+1]&0x10;if (temp==0)return(0);else return(1);}
    case 9:{temp=year_code[table_addr+1]&0x08;if (temp==0)return(0);else return(1);}
    case 10:{temp=year_code[table_addr+1]&0x04;if (temp==0)return(0);else return(1);}
    case 11:{temp=year_code[table_addr+1]&0x02;if (temp==0)return(0);else return(1);}
    case 12:{temp=year_code[table_addr+1]&0x01;if (temp==0)return(0);else return(1);}
    case 13:{temp=year_code[table_addr+2]&0x80;if (temp==0)return(0);else return(1);}
  }

  return 0;
}

u8 _cror_(u8 temp,u8 n)
{
  u8 i,j;

  for (i=n; i>0; i--)
  {
    j = 0;
    if (temp & 0x01) {
        j = 0x80;
    }
    temp = temp >> 1;
    temp |= j;
  }

  return temp;
}

u8 _crol_(u8 temp,u8 n)
{
  u8 i,j;

  for (i=n; i>0; i--)
  {
    j = 0;
    if (temp & 0x80) {
        j = 0x01;
    }
    temp = temp << 1;
    temp |= j;
  }

  return temp;
}

void Conversion(u8 c,u8 year,u8 month,u8 day)
{
  u8 temp1,temp2,temp3,month_p;
  u16 temp4,table_addr;
  u8 flag2,flag_y;

  temp1 = year/10;
  temp2 = year%10;
  year = temp1*10+temp2;
  temp1 = month/10;
  temp2 = month%10;
  month = temp1*10+temp2;
  temp1 = day/10;
  temp2 = day%10;
  day = temp1*10+temp2;

  if (c==0){
    table_addr = (year+0x64-1)*0x3;
  }
  else {
    table_addr = (year-1)*0x03;
  }

  temp1 = year_code[table_addr+2]&0x60;
  temp1 = _cror_(temp1,5);
  temp2 = year_code[table_addr+2]&0x1f;

  if (temp1==0x1) {
    temp3 = temp2-1;
  }
  else{
    temp3 = temp2+0x1f-1;
  }

  if (month<10) {
    temp4 = day_code1[month-1]+day-1;
  }
  else{
    temp4 = day_code2[month-10]+day-1;
  }
  if ((month>0x2)&&(year%0x4==0)) {
    temp4 += 1;
  }

  if (temp4 >= temp3) {
    temp4 -= temp3;
    month = 0x1;
    month_p = 0x1;
    flag2 = get_moon_day(month_p,table_addr);
    flag_y = 0;
    if (flag2==0) temp1 = 0x1d;
    else temp1=0x1e;
    temp2 = year_code[table_addr]&0xf0;
    temp2 = _cror_(temp2,4);
    while (temp4>=temp1) {
      temp4 -= temp1;
      month_p += 1;
      if (month==temp2) {
        flag_y = ~flag_y;
        if (flag_y==0) month += 1;
      }
      else month += 1;
      flag2 = get_moon_day(month_p,table_addr);
      if (flag2==0) temp1 = 0x1d;
      else temp1 = 0x1e;
    }
    day = temp4+1;
  }
  else{
    temp3 -= temp4;
    if (year==0x0) {year=0x63;c=1;}
    else year -= 1;
    table_addr -= 0x03;
    month = 0xc;
    temp2 = year_code[table_addr]&0xf0;
    temp2 = _cror_(temp2,4);
    if (temp2==0) month_p = 0xc;
    else month_p = 0xd;

    flag_y = 0;
    flag2 = get_moon_day(month_p,table_addr);
    if (flag2==0) temp1 = 0x1d;
    else temp1 = 0x1e;
    while (temp3>temp1) {
      temp3 -= temp1;
      month_p -= 1;
      if (flag_y==0) month -= 1;
      if (month==temp2) flag_y = ~flag_y;
      flag2 = get_moon_day(month_p,table_addr);
      if (flag2==0) temp1 = 0x1d;
      else temp1 = 0x1e;
    }
    day = temp1-temp3+1;
  }

  temp1 = year/10;
  temp1 = _crol_(temp1,4);
  temp2 = year%10;
  year_moon = temp1|temp2;
  temp1 = month/10;
  temp1 = _crol_(temp1,4);
  temp2 = month%10;
  month_moon = temp1|temp2;
  temp1 = day/10;
  temp1 = _crol_(temp1,4);
  temp2 = day%10;
  day_moon = temp1|temp2;
}

void HUB75D_CalcYinli(rtc_counter_value_t *time)
{
  u8 dd= time->day;
  u8 mo= time->month;
  u8 yy= time->year%100;

  Conversion(0,yy,mo,dd);
  ny1 = (year_moon&0x70)>>4;
  ny0 = year_moon&0x0F;
  nm1 = (month_moon&0x70)>>4;
  nm0 = month_moon&0x0F;
  nd1 = (day_moon&0x70)>>4;
  nd0 = day_moon&0x0F;
}

void DispTime(u8 i)
{
  if (h1==0) {
    h1 = 10;
  }
  if (f1>=4) {
    zr[0]|=DZF[h1][i];  //h1
    zg[0]|=DZF[h1][i];  //h1
    zb[0]|=DZF[h1][i];  //h1
    zr[1]|=(DZF[h0][i]>>1);     //h0
    zr[2]|=(DZF[h0][i]<<7);     //h0
    zg[1]|=(DZF[h0][i]>>1);     //h0
    zg[2]|=(DZF[h0][i]<<7);     //h0
    zb[1]|=(DZF[h0][i]>>1);     //h0
    zb[2]|=(DZF[h0][i]<<7);     //h0
    zr[2]|=DZF[sd][i];  //sd
    zb[2]|=DZF[sd][i];  //sd
    zr[3]|=DZF[f1][i];  //f1
    zg[3]|=DZF[f1][i];  //f1
    zb[3]|=DZF[f1][i];  //f1
    zr[4]|=(DZF[f0][i]>>1);     //f0
    zr[5]|=(DZF[f0][i]<<7);     //f0
    zg[4]|=(DZF[f0][i]>>1);     //f0
    zg[5]|=(DZF[f0][i]<<7);     //f0
    zb[4]|=(DZF[f0][i]>>1);     //f0
    zb[5]|=(DZF[f0][i]<<7);     //f0
    zr[5]|=DZF[sd][i];  //sd
    zb[5]|=DZF[sd][i];  //sd
    zr[6]|=ZZF[s1][i];  //s1
    zg[6]|=ZZF[s1][i];  //s1
    zb[6]|=ZZF[s1][i];  //s1
    zr[7]|=ZZF[s0][i];  //s0
    zg[7]|=ZZF[s0][i];  //s0
    zb[7]|=ZZF[s0][i];  //s0
  }
  else if (f1>=2) {
    zg[0]|=DZF[h1][i];  //h1
    zg[1]|=(DZF[h0][i]>>1);     //h0
    zg[2]|=(DZF[h0][i]<<7);     //h0
    zr[2]|=DZF[sd][i];  //sd
    zg[2]|=DZF[sd][i];  //sd
    zg[3]|=DZF[f1][i];  //f1
    zg[4]|=(DZF[f0][i]>>1);     //f0
    zg[5]|=(DZF[f0][i]<<7);     //f0
    zr[5]|=DZF[sd][i];  //sd
    zg[5]|=DZF[sd][i];  //sd
    zg[6]|=ZZF[s1][i];  //s1
    zg[7]|=ZZF[s0][i];  //s0
  }
  else {
    zr[0] |= DZF[h1][i];        //h1
    zg[0] |= DZF[h1][i];
    //zb[0] |= DZF[h1][i];
    zr[1] |= (DZF[h0][i]>>1);   //h0
    zg[1] |= (DZF[h0][i]>>1);
    //zb[1] |= (DZF[h0][i]>>1);
    zr[2] |= (DZF[h0][i]<<7);   //h0
    zg[2] |= (DZF[h0][i]<<7);
    //zb[2] |= (DZF[h0][i]<<7);
    zg[2] |= DZF[sd][i];        //sd
    zr[3] |= DZF[f1][i];        //f1
    zg[3] |= DZF[f1][i];
    //zb[3] |= DZF[f1][i];
    zr[4] |= (DZF[f0][i]>>1);   //f0
    zg[4] |= (DZF[f0][i]>>1);
    //zb[4] |= (DZF[f0][i]>>1);
    zr[5] |= (DZF[f0][i]<<7);   //f0
    zg[5] |= (DZF[f0][i]<<7);
    //zb[5] |= (DZF[f0][i]<<7);
    zg[5] |= DZF[sd][i];        //sd
    zr[6] |= ZZF[s1][i];        //s1
    zg[6] |= ZZF[s1][i];
    //zb[6] |= ZZF[s1][i];
    zr[7] |= ZZF[s0][i];        //s0
    zg[7] |= ZZF[s0][i];
    //zb[7]|= ZZF[s0][i];
  }
}

void DispDate(u8 i)
{
  u8 k;

  if (f1>=2) {
    zg[8]|=(ZF[2*8+i]<<4);      //2		8-5 前4列，6列空
    zg[8]|=(ZF[0*8+i]>>1);      //0, 前3位	8-8
    zg[9]|=(ZF[0*8+i]<<7);      //0, 后1位	9-3  4列空
    zg[9]|=(ZF[y1*8+i]<<2);     //y1 前4位	9-8  5列空
    zg[9]|=(ZF[y0*8+i]>>3);     //y0 前1位	10-1 2列空
    for (k=8; k<10; k++) {
      zr[k]=zg[k];      // 黄色
    }
    zg[10]|=(ZF[y0*8+i]<<5);    //y0 前3位	10-3  12列空
    zr[10]|=(ZF[y0*8+i]<<5);    //黄色

    zg[10]|=(HZ[10*8+i]>>2);    //年 ,		10-8
    zg[11]|=(HZ[10*8+i]<<6);    //年 ,		11-2
    if (m1==0) {
      m1=11;
    }
    zg[11]|=(ZF[m1*8+i]<<1);    //m1 3位	11-7
    zr[11]|=(ZF[m1*8+i]<<1);    // 黄色
    zg[12]|=(ZF[m0*8+i]<<4);    //m9 5	12-4
    zr[12]|=(ZF[m0*8+i]<<4);    // 黄色

    zg[12]|=(HZ[9*8+i]>>1);     //月 前4位	12-8 后5列
    zg[13]|=(HZ[9*8+i]<<7);     //月 后1位	13-11
    if (d1==0) {
      d1=11;
    }
    zg[13]|=(ZF[d1*8+i]<<2);    //d1 前3位	13-76   前5列
    zr[13]|=(ZF[d1*8+i]<<2);    // 黄色
    zg[13]|=(ZF[d0*8+i]>>3);    //d0  		14-5
    zr[13]|=(ZF[d0*8+i]>>3);    // 黄色
    zg[14]|=(ZF[d0*8+i]<<5);    //d0  		14 3
    zr[14]|=(ZF[d0*8+i]<<5);    // 黄色

    zg[14]|=(HZ[8*8+i]);        //日 后4位	14-88
    //for (k=8; k<15; k++) zr[k]=zg[k];	// 黄色
    zr[15]|=HZ[(wk-0)*8+i];     //week		15-3~15-8
  } else {
    zg[8]|=(ZF[2*8+i]<<4);      //2		8-5 前4列，6列空
    zg[8]|=(ZF[0*8+i]>>1);      //0, 前3位	8-8
    zg[9]|=(ZF[0*8+i]<<7);      //0, 后1位	9-3  4列空
    zg[9]|=(ZF[y1*8+i]<<2);     //y1 前4位	9-8  5列空
    zg[9]|=(ZF[y0*8+i]>>3);     //y0 前1位	10-1 2列空
    zg[10]|=(ZF[y0*8+i]<<5);    //y0 前3位	10-3  12列空

    zr[10]|=(HZ[10*8+i]>>2);    //年 ,		10-8
    zr[11]|=(HZ[10*8+i]<<6);    //年 ,		11-2
    if (m1==0) {
      m1=11;
    }
    zg[11]|=(ZF[m1*8+i]<<1);    //m1 3位	11-7
    zg[12]|=(ZF[m0*8+i]<<4);    //m9 5	12-4

    zr[12]|=(HZ[9*8+i]>>1);     //月 前4位	12-8 后5列
    zr[13]|=(HZ[9*8+i]<<7);     //月 后1位	13-11
    if (d1==0) {
      d1=11;
    }
    zg[13]|=(ZF[d1*8+i]<<2);    //d1 前3位	13-76   前5列
    zg[13]|=(ZF[d0*8+i]>>3);    //d0  		14-5
    zg[14]|=(ZF[d0*8+i]<<5);    //d0  		14 3

    zr[14]|=(HZ[8*8+i]);        //日 后4位	14-88
    zg[15]|=HZ[(wk-0)*8+i];     //week		15-3~15-8
  }   //i<8
}

void DispYinli(u8 i)
{
  u8 j;
  u16 tmp;

  j=i-8;
  //Get_yinli();
  if (f1>=2) {
    zg[8]|=HZ[7*8+j]; //农后5列   8-77
    if (nm1==0) {
      nm1=11;
    }
    zr[9]|=(ZF[nm1*8+j]<<4); //nm1  5位	9-4
    zr[9]|=(ZF[nm0*8+j]>>1); //nm0 前2位 9-8
    zr[10]|=(ZF[nm0*8+j]<<7); //nm0 后3位 10-1
    zg[10]|=(HZ[9*8+j]<<1); //月 前1位 10-7
    if (nd1==0) {
      nd1=11;
    }
    zr[11]|=(ZF[nd1*8+j]<<4); //d1 前4位 10-8
    zr[11]|=(ZF[nd0*8+j]>>1); //d0 后1	11-7
    zr[12]|=(ZF[nd0*8+j]<<7); //d0 后1	11-7
    zg[12]|=(HZ[8*8+j]<<2); // 1位	11-8

    if (F_HUB75D_TH_DISP_CHANGE == _DISP_T_) {
      if (Temperature < 0) {
        sign = 1;
        tmp = ~Temperature+1;
      } else {
        tmp = Temperature;
      }
      t1 = tmp/100;
      t0 = tmp%100/10;
      td = tmp%10;
      if (sign == 0) {
        if (t1 == 0x00) {
          t1 = 11; //' '
        }
      } else {
        if (t1 == 0x00) {
          t1 = 12; //'-'
        }
      }
    } else {
      tmp = Humidity;
      t1 = tmp/100;
      t0 = tmp%100/10;
      td = tmp%10;
      if (t1 == 0x00) {
        t1 = 11;
      }
    }

    if (sign==1) {
      if (t1 != 0x00) {
        zr[12]|=(DateD[12][j]>>6); //-	12-6
        zr[13]|=(DateD[12][j]<<2); //-	13-1
      }
    }
    zr[13]|=(DateD[t1][j]>>1); //t1	13-4
    zr[13]|=(DateD[t0][j]>>7); //t0 3	13-8
    zr[14]|=(DateD[t0][j]<<1); //t0 2	14-4
    zr[14]|=(DateD[13][j]>>4); //. `   14-5
    zg[14]|=(DateD[13][j]>>4); // 黄色
    zr[14]|=(DateD[td][j]>>5); //td 3   14-8
    zr[15]|=(DateD[td][j]<<3); //td 2	15-2
    if (F_HUB75D_TH_DISP_CHANGE == _DISP_T_) {
      zg[15]|=(DateD[14][j]>>3); // C
    } else {
      zg[15]|=(DateD[15][j]>>3); // %
    }
  } else {
    zr[8]|=HZ[7*8+j]; //农后5列   8-77
    if (nm1==0) {
      nm1=11;
    }
    zg[9]|=(ZF[nm1*8+j]<<4); //nm1  5位 9-4
    zg[9]|=(ZF[nm0*8+j]>>1); //nm0 前2位 9-8
    zg[10]|=(ZF[nm0*8+j]<<7); //nm0 后3位 10-1
    zr[10]|=(HZ[9*8+j]<<1); //月 前1位 10-7
    if (nd1==0) {
      nd1=11;
    }
    zg[11]|=(ZF[nd1*8+j]<<4); //d1 前4位 10-8
    zg[11]|=(ZF[nd0*8+j]>>1); //d0 后1 11-7
    zg[12]|=(ZF[nd0*8+j]<<7); //d0 后1 11-7
    zr[12]|=(HZ[8*8+j]<<2); //日 前1位 11-8

    if (F_HUB75D_TH_DISP_CHANGE == _DISP_T_) {
      if (Temperature < 0) {
        sign = 1;
        tmp = ~Temperature+1;
      } else {
        tmp = Temperature;
      }
      t1 = tmp/100;
      t0 = tmp%100/10;
      td = tmp%10;
      if (sign == 0) {
        if (t1 == 0x00) {
          t1 = 11; //' '
        }
      } else {
        if (t1 == 0x00) {
          t1 = 12; //'-'
        }
      }
    } else {
      tmp = Humidity;
      t1 = tmp/100;
      t0 = tmp%100/10;
      td = tmp%10;
      if (t1 == 0x00) {
        t1 = 11;
      }
    }

    if (sign==1) {
      if (t1 != 0x00) {
        zg[12]|=(DateD[12][j]>>6); //- 12-6
        zg[13]|=(DateD[12][j]<<2); //- 13-1
      }
    }
    zg[13]|=(DateD[t1][j]>>1); //t1 13-4
    zg[13]|=(DateD[t0][j]>>7); //t0 3 13-8
    zg[14]|=(DateD[t0][j]<<1); //t0 2 14-4
    zr[14]|=(DateD[13][j]>>4); //. `   14-5
    zg[14]|=(DateD[td][j]>>5); //td 3   14-8
    zg[15]|=(DateD[td][j]<<3); //td 2 15-2
    if (F_HUB75D_TH_DISP_CHANGE == _DISP_T_) {
      zr[15]|=(DateD[14][j]>>3); //C
    } else {
      zr[15]|=(DateD[15][j]>>3); //%
    }
  } //>8
}

void HUB75D_CalcClock(rtc_counter_value_t *time)
{
  static u8 i;

  i++;
  if (i > 4) {
    i = 0x00;
    if (F_HUB75D_TH_DISP_CHANGE == _DISP_T_) {
      F_HUB75D_TH_DISP_CHANGE = _DISP_H_;
    } else {
      F_HUB75D_TH_DISP_CHANGE = _DISP_T_;
    }
  }

  h0 = time->hour%10;
  h1 = time->hour/10;
  f0 = time->min%10;
  f1 = time->min/10;
  s0 = time->sec%10;
  s1 = time->sec/10;

  d0 = time->day%10;
  d1 = time->day/10;
  m0 = time->month%10;
  m1 = time->month/10;
  y0 = time->year%100%10;
  y1 = time->year%100/10;
  wk = time->week;
  sd = 11;//":"
}

void HUB75D_DispScan(void)
{
    static u8 i;
    u8 k,x;

    DispTime(i);
    if (i<8) {
        DispDate(i);
    } else {
        DispYinli(i);
    }

    HUB_LAT=0;
    HUB_OE=1;
    for (k=0; k<8; k++)
    {
      for (x=0; x<8; x++)
      {
        if (zr[k+8] & 0x80) {
            HUB_R1 = 1;
        } else {
            HUB_R1 = 0;
        }
        if (zg[k+8] & 0x80) {
            HUB_G1 = 1;
        } else {
            HUB_G1 = 0;
        }
        if (zb[k+8] & 0x80) {
            HUB_B1 = 1;
        } else {
            HUB_B1 = 0;
        }

        if (zr[k] & 0x80) {
            HUB_R2 = 1;
        } else {
            HUB_R2 = 0;
        }
        if (zg[k] & 0x80) {
            HUB_G2 = 1;
        } else {
            HUB_G2 = 0;
        }
        if (zb[k] & 0x80) {
            HUB_B2 = 1;
        } else {
            HUB_B2 = 0;
        }

        zr[k+8] = zr[k+8] << 1;
        zg[k+8] = zg[k+8] << 1;
        zb[k+8] = zb[k+8] << 1;
        zr[k] = zr[k] << 1;
        zg[k] = zg[k] << 1;
        zb[k] = zb[k] << 1;
        HUB_CLK=1;
        HUB_CLK=0;
      }
    }

    if (i&0x01) {
        HUB_A = 1;
    } else {
        HUB_A = 0;
    }
    if (i&0x02) {
        HUB_B = 1;
    } else {
        HUB_B = 0;
    }
    if (i&0x04) {
        HUB_C = 1;
    } else {
        HUB_C = 0;
    }
    if (i&0x08) {
        HUB_D = 1;
    } else {
        HUB_D = 0;
    }

    HUB_LAT=1;
    HUB_OE=0;

    i++;
    if (i > 15) {
        i = 0x00;
    }
}

void HUB75D_DispOnOff(HUB75D_DispOnOffFlag F_tmp)
{
  if (F_tmp == _DISP_ON_) {
    HUB75D_DISP_POWER_PIN = _DISP_ON_;
    F_HUB75D_DISP_ON_OFF = _DISP_ON_;
    HUB75D_DispOffCtr = _DISP_OFF_TIME_5MIN_;
  } else {
    HUB75D_DISP_POWER_PIN = _DISP_OFF_;
    F_HUB75D_DISP_ON_OFF = _DISP_OFF_;
    HUB75D_DispOffCtr = 0x00;
    HUB_A = 0;
    HUB_B = 0;
    HUB_C = 0;
    HUB_D = 0;
    HUB_OE = 0;
    HUB_LAT = 0;
    HUB_CLK = 0;
    HUB_R1 = 0;
    HUB_G1 = 0;
    HUB_B1 = 0;
    HUB_R2 = 0;
    HUB_G2 = 0;
    HUB_B2 = 0;
  }
}

void HUB75D_CtrDec(void)
{
  if (HUB75D_DispOffCtr) {
    HUB75D_DispOffCtr--;
    if (HUB75D_DispOffCtr == 0x00) {
      EnterStandbyMode();
    }
  }
}
